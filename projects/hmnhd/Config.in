## projects/hmnhd/configs/hmnhd_defconfig
```kconfig
BR2_arm=y
BR2_arm1176jz_s=y
BR2_CCACHE=y
BR2_CCACHE_DIR="/tmp/.buildroot-ccache"
BR2_GLOBAL_PATCH_DIR="$(BR2_EXTERNAL)/board/patches"
BR2_KERNEL_HEADERS_VERSION=y
BR2_DEFAULT_KERNEL_VERSION="2.6.31.14"
BR2_UCLIBC_VERSION_0_9_33=y
BR2_UCLIBC_CONFIG="package/uclibc/uClibc-ng.config"
BR2_TOOLCHAIN_BUILDROOT_WCHAR=y
BR2_TOOLCHAIN_BUILDROOT_CXX=y
BR2_PACKAGE_PERL=y
BR2_PACKAGE_LIBGCRYPT=y
BR2_PACKAGE_NBD=y
# BR2_NBD_CLIENT is not set
BR2_NBD_SERVER=y
BR2_PACKAGE_OPENSSH=y
BR2_PACKAGE_SOCAT=y
# BR2_TARGET_ROOTFS_TAR is not set
BR2_PACKAGE_ARIA2=y
```

## projects/hmnhd/package/aria2/Config.in
```kconfig
config BR2_PACKAGE_ARIA2
	bool "aria2"
	select BR2_PACKAGE_GNUTLS
	select BR2_PACKAGE_PKGCONF
	select BR2_PACKAGE_NETTLE
	select BR2_PACKAGE_SQLITE
	select BR2_PACKAGE_LIBXML2
	select BR2_PACKAGE_C_ARES
	select BR2_PACKAGE_GMP
	select BR2_PACKAGE_LIBSSH2
	select BR2_PACKAGE_ZLIB
	help
	  aria2 is a lightweight multi-protocol & multi-source command-line download utility.
	  It supports HTTP/HTTPS, FTP, SFTP, BitTorrent and Metalink. aria2 can be manipulated
	  via built-in JSON-RPC and XML-RPC interfaces.

	  http://aria2.sourceforge.net/
```
